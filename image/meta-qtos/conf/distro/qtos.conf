## image/meta-qtos/conf/layer.conf
```bitbake
# meta-qtos — the QTOS distribution layer.
BBPATH .= ":${LAYERDIR}"

BBFILES += "${LAYERDIR}/recipes-*/*/*.bb \
            ${LAYERDIR}/recipes-*/*/*.bbappend"

BBFILE_COLLECTIONS += "qtos"
BBFILE_PATTERN_qtos = "^${LAYERDIR}/"
BBFILE_PRIORITY_qtos = "10"

LAYERDEPENDS_qtos = "core qt6-layer openembedded-layer"
LAYERSERIES_COMPAT_qtos = "scarthgap"
```
